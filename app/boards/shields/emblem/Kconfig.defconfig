## app/boards/shields/emblem/Kconfig.defconfig
```kconfig
# Copyright (c) 2022 The ZMK Contributors
# SPDX-License-Identifier: MIT

if SHIELD_EMBLEM_LEFT

    config ZMK_KEYBOARD_NAME
        default "Emblem"

    config ZMK_SPLIT_ROLE_CENTRAL
        default y

endif

if SHIELD_EMBLEM

    config ZMK_BLE
        default y

    config ZMK_SPLIT
        default y

    config ZMK_SPLIT_ROLE_CENTRAL
        default n

endif
```

## app/boards/shields/emblem/Kconfig.shield
```kconfig
# Copyright (c) 2022 The ZMK Contributors
# SPDX-License-Identifier: MIT

config SHIELD_EMBLEM
    bool

config SHIELD_EMBLEM_LEFT
    def_bool $(shields_list_contains,emblem_left)
    select SHIELD_EMBLEM

config SHIELD_EMBLEM_RIGHT
    def_bool $(shields_list_contains,emblem_right)
    select SHIELD_EMBLEM

config SHIELD_EMBLEM_DONGLE
    def_bool $(shields_list_contains,emblem_dongle)
    select SHIELD_EMBLEM
```

## app/boards/shields/sharp_memory_display/Kconfig.shield
```kconfig
# Copyright (c) 2022 The ZMK Contributors
# SPDX-License-Identifier: MIT

config SHIELD_SHARP_MEMORY_DISPLAY
    def_bool $(shields_list_contains,sharp_memory_display)
```
